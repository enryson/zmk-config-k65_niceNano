#include <dt-bindings/zmk/matrix_transform.h>

/ {
	kscan0: kscan {
		compatible = "zmk,kscan-gpio-matrix";
		label = "KSCAN";
		
		diode-direction = "col2row";
		
		row-gpios
		= <&pro_micro_d 9 (GPIO_ACTIVE_HIGH | GPIO_PULL_DOWN)>
		, <&pro_micro_d 8 (GPIO_ACTIVE_HIGH | GPIO_PULL_DOWN)>
		;
		
		col-gpios
		= <&pro_micro_d 1 GPIO_ACTIVE_HIGH>
		;
	};
	
	default_transform: keymap_transform_0 {
		compatible = "zmk,matrix-transform";
		rows = <2>;
		columns = <1>;
		
		map = <
		RC(0,0) RC(1,0)
		>;
	};
	
	chosen {
		zmk,kscan = &kscan0;
		zmk,matrix_transform = &default_transform;
	};
};
