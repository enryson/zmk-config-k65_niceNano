## config/boards/shields/k65/Kconfig.defconfig
```kconfig
# Copyright (c) 2020 The ZMK Contributors
# SPDX-License-Identifier: MIT

config ZMK_KEYBOARD_NAME
    default "k65"

config USB_NRFX
    default y

config BT_CTLR
    default BT
```

## config/boards/shields/plancklow/Kconfig.defconfig
```kconfig
# Copyright (c) 2020 The ZMK Contributors
# SPDX-License-Identifier: MIT

if SHIELD_PLANCKLOW

config ZMK_KEYBOARD_NAME
    default "plancklow"

endif
```
